## CMakeLists.txt
```
#
# Copyright (c) 2020 Nordic Semiconductor
#
# SPDX-License-Identifier: LicenseRef-Nordic-5-Clause
#

cmake_minimum_required(VERSION 3.20.0)

find_package(Zephyr REQUIRED HINTS $ENV{ZEPHYR_BASE})
project(aws_iot)

target_sources(app PRIVATE src/main.c)
target_sources(app PRIVATE led/led.c)
target_sources(app PRIVATE led/color.c)
target_sources(app PRIVATE msg/glucose_msg.c)
target_sources(app PRIVATE mqtt/mqtt_client.c)
target_sources(app PRIVATE network/network.c)

zephyr_include_directories(src)
zephyr_include_directories(led)
zephyr_include_directories(msg)
zephyr_include_directories(util)
zephyr_include_directories(mqtt)
zephyr_include_directories(network)
```

## prj.conf
```kconfig
#
# Copyright (c) 2020 Nordic Semiconductor ASA
#
# SPDX-License-Identifier: LicenseRef-Nordic-5-Clause
#

# General
CONFIG_LOG=y
CONFIG_LOG_BUFFER_SIZE=2048
CONFIG_HW_ID_LIBRARY=y
CONFIG_ASSERT=y
CONFIG_JSON_LIBRARY=y
CONFIG_REBOOT=y

# Heap and stacks
CONFIG_HEAP_MEM_POOL_SIZE=8192
CONFIG_MAIN_STACK_SIZE=4096
CONFIG_SYSTEM_WORKQUEUE_STACK_SIZE=2048
CONFIG_AT_MONITOR_HEAP_SIZE=2048

# Network
CONFIG_NETWORKING=y
CONFIG_NET_NATIVE=y
CONFIG_NET_IPV4=y
CONFIG_NET_CONNECTION_MANAGER=y

# AWS IoT library
CONFIG_AWS_IOT=y
CONFIG_AWS_IOT_CLIENT_ID_STATIC="glucopet"
CONFIG_AWS_IOT_BROKER_HOST_NAME="a3tnwpx5rjol8f-ats.iot.us-east-1.amazonaws.com"

# MQTT helper library
CONFIG_MQTT_HELPER=y
CONFIG_MQTT_HELPER_SEC_TAG=201
CONFIG_MQTT_HELPER_LAST_WILL=y
CONFIG_MQTT_HELPER_STACK_SIZE=4096

# MQTT - Maximum MQTT keepalive timeout specified by AWS IoT Core
CONFIG_MQTT_KEEPALIVE=1200
CONFIG_MQTT_CLEAN_SESSION=y

# LED driver
CONFIG_PWM=y

# Configuration file for Thingy:91 X
# This file is merged with prj.conf in the application folder, and options
# set here will take precedence if they are present in both files.

# General
CONFIG_HW_STACK_PROTECTION=y
CONFIG_HW_ID_LIBRARY_SOURCE_IMEI=y
CONFIG_PICOLIBC=y

# Modem related configurations
CONFIG_MODEM_INFO=y
CONFIG_AT_HOST_LIBRARY=y

#CONFIG_LTE_LC_EDRX_MODULE=y
#CONFIG_LTE_EDRX_REQ=y
#CONFIG_LTE_EDRX_REQ_VALUE_LTE_M="0101"

# Modem trace
CONFIG_NRF_MODEM_LIB_TRACE=y
CONFIG_NRF_MODEM_LIB_TRACE_BACKEND_UART=y
CONFIG_SERIAL=y
CONFIG_UART_ASYNC_API=y
CONFIG_UART_1_ASYNC=y
CONFIG_UART_1_INTERRUPT_DRIVEN=n

# Disable Duplicate Address Detection (DAD)
# due to not being properly implemented for offloaded interfaces.
CONFIG_NET_IPV6_NBR_CACHE=n
CONFIG_NET_IPV6_MLD=n

# Zephyr NET Connection Manager and Connectivity layer.
CONFIG_NET_CONNECTION_MANAGER_MONITOR_STACK_SIZE=1024
CONFIG_NRF_MODEM_LIB_NET_IF=y

# Bootloader and FOTA related configurations

# MCUBOOT
CONFIG_BOOTLOADER_MCUBOOT=y
CONFIG_MCUBOOT_IMG_MANAGER=y

# Image manager
CONFIG_IMG_MANAGER=y
CONFIG_STREAM_FLASH=y
CONFIG_FLASH_MAP=y
CONFIG_FLASH=y
CONFIG_IMG_ERASE_PROGRESSIVELY=y
```

## src/main.c
```c
/*
 * Copyright (c) 2020 Nordic Semiconductor ASA
 *
 * SPDX-License-Identifier: LicenseRef-Nordic-5-Clause
 */

#include <zephyr/kernel.h>
#include <zephyr/logging/log.h>

#include <stdio.h>
#include <stdlib.h>

#include "error.h"
#include "led.h"
#include "mqtt_client.h"
#include "network.h"

LOG_MODULE_REGISTER(sugarcube, CONFIG_AWS_IOT_SAMPLE_LOG_LEVEL);

// Blood glucose helpers to convert bg to color
#define BG_SCALE(g, low, high) (((float)(g - low))/(high - low))

// Map between BG and LED color
#define BG_VLOW_VALUE	55
#define BG_VLOW_COLOR	COLOR_RED

#define BG_LOW_VALUE 	152
#define BG_LOW_COLOR	COLOR_GREEN

#define BG_MED_VALUE 	250
#define BG_MED_COLOR    COLOR_BLUE

#define BG_HIGH_VALUE	300
#define BG_HIGH_COLOR	COLOR_PURPLE


static int bg_to_color(int g, color_t *c);
void test_led(led_handle_t led);

// Callbacks
static void on_glucose(int glucose);
static void net_evt_cb(net_evt_t evt, void *ctx);

// LED handle
static led_handle_t led = NULL;

int main(void)
{
	int err;

	led = led_init(LED_1);
	test_led(led);
	led_color_set(led, &COLOR_WHITE);

	// Enable connectivity
	LOG_INF("Bringing network interface up and connecting to the network");
	network_cb_reg(net_evt_cb);
	network_init();

	// Connect to AWS IOT server
	err = mqtt_appclient_init();
	if (err) {
		LOG_ERR("mqtt_client_init, error: %d", err);
		FATAL_ERROR();
		return err;
	}

	mqtt_appclient_reg_glucose_cb(on_glucose);

	return 0;
}

void net_evt_cb(net_evt_t evt, void *ctx)
{
	switch (evt)
	{
		case NET_EVT_CONNECTED:
			mqtt_appclient_connection_start();
			break;

		case NET_EVT_DISCONNECTED:
			mqtt_appclient_connection_stop();
			break;
	}
}

void on_glucose(int glucose)
{
	color_t c;
	if (led != NULL)
	{
		bg_to_color(glucose, &c);
		led_color_set(led, &c);
	}
}

int bg_to_color(int g, color_t *c) 
{
    if (g < 0)
	{
		// Invalid glucose
		return -1;
	}       
	else if (g < BG_VLOW_VALUE)
	{
		// Very low
		memcpy(c, &BG_VLOW_COLOR, sizeof(BG_VLOW_COLOR));
	}
	else if (g < BG_LOW_VALUE)
	{
		// Low
		color_interp(
			&BG_VLOW_COLOR, &BG_LOW_COLOR,
			BG_SCALE(g, BG_VLOW_VALUE, BG_LOW_VALUE),
			c
		);
	}
	else if (g < BG_MED_VALUE)
	{
		// Medium
		color_interp(
			&BG_LOW_COLOR, &BG_MED_COLOR, 
			BG_SCALE(g, BG_LOW_VALUE, BG_MED_VALUE),
			c
		);
	}
	else if (g < BG_HIGH_VALUE)
	{
		// High
		color_interp(
			&BG_MED_COLOR, &BG_HIGH_COLOR, 
			BG_SCALE(g, BG_MED_VALUE, BG_HIGH_VALUE),
			c
		);
	}
	else
	{
		// Very high
		memcpy(c, &BG_HIGH_COLOR, sizeof(BG_HIGH_COLOR));
	}

	return 0;
}

void test_led(led_handle_t led)
{
	color_t c;
	for (int g=0; g<350; g+=10)
	{
		bg_to_color(g, &c);
		led_color_set(led, &c);
		k_msleep(100);
	}
}
```
